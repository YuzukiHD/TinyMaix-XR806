## Kconfig
```kconfig
#
# For a description of the syntax of this configuration file,
# see config/kconfig-language.txt.
#
mainmenu "XR806 SDK Configuration"


# Projects select
config PROJECT
	string "Projects Selected"
	default ""
	help
		[test/driver_test demo/wlan_demo examples/uart ...] Projects Selsected


source "project/Kconfig"

# power configuration
choice SENSE_POWER_SUPPLY
    prompt "VDD_SENSE power supply mode"
    default PWR_INTERNAL_LDO
    help
        VDD_SENSE power supply mode:

        - internal LDO
        - internal DCDC
        - external Power

config PWR_INTERNAL_LDO
    bool "Use internal LDO"
config PWR_INTERNAL_DCDC
    bool "Use internal DCDC"
config PWR_EXTERNAL
    bool "external power"
endchoice

# net and wlan
menuconfig WLAN
    bool "NET and WLAN"
    default n
    help
        If this option is enabled, NET and WLAN used.

if WLAN
source "src/net/Kconfig"
source "src/wlan/Kconfig"
endif

menuconfig BLE_FEATURE
	bool "BLE"
	default n
	help
	  This option enables Bluetooth support.

if BLE_FEATURE

config BLE
    bool "BLE Controller"
    default y
    help
        If this option is enabled, BLE Controller used.

source "src/ble/Kconfig"

endif


menuconfig FILESYSTEMS
	bool "filesystem support"
	default n
	help
	  If this option is enabled, filesystem used.

if FILESYSTEMS
source "src/fs/Kconfig"
endif

source "src/kernel/Kconfig"

source "src/driver/Kconfig"


# power management
menuconfig PM
    bool "Power management"
	depends on !BOOTLOADER && !ETF
    default y
    help
        power management.

if PM
source "src/pm/Kconfig"
endif


source "src/trustzone/Kconfig"


# Feature configuration
source "src/libc/Kconfig"


# Debug configuration
source "src/debug/Kconfig"

# C++ configuration
config CPLUSPLUS
    bool "C++ support"
    default n
    help
        This option enables C++ support.
```

## project/Kconfig
```kconfig
#
# Project configuration.
#

menu "Project settings"

# Platform
#config PLATFORM_FPGA
#	bool "Platform FPGA select"
#	default n
#	help
#		[FPGA] platform select

# Chip select
choice CHIP_TYPE
    prompt "Chip select"
    default CHIP_XR806
    help
        XRADIO SDK Currently supports the following chips:

        - xr806

config CHIP_XR806
    bool "xr806"
endchoice

choice XTAL_FREQ_SEL
    prompt "XTAL frequency"
    default HOSC_TYPE_40M
    help
        XR806 Currently supports the following XTAL frequencies:

        - 24 MHz
        - 26 MHz
        - 32 MHz
        - 40 MHz

config HOSC_TYPE_24M
    bool "24 MHz"
config HOSC_TYPE_26M
    bool "26 MHz"
config HOSC_TYPE_32M
    bool "32 MHz"
config HOSC_TYPE_40M
    bool "40 MHz"
endchoice


# Projects board select
config BOARD
	string "Projects board selected"
	default "xr806_dig_ver"
	help
	  [xradio_bl/xradio_evb/xradio_ai/...] Boards Selsected


# XIP
config XIP
    bool "XIP"
    default y
    help
        If this option is enabled, XIP code can be used.

config PSRAM
    bool "PSRAM"
     default n
    help
        If this option is enabled, PSRAM can be used.

config CACHE
    bool "CACHE"
    depends on (XIP || PSRAM) && !BOOTLOADER
    default y
    help
        If this option is enabled, CACHE can be used.

# Cache and size select
choice
	prompt "Cache Size Select"
	depends on CACHE
	default CACHE_SIZE_32K
	help
	  Select Cache.

config CACHE_SIZE_8K
	bool "8k"
	help
	  Use cache size 8K
config CACHE_SIZE_16K
	bool "16k"
	help
	  Use cache size 16K
config CACHE_SIZE_32K
	bool "32k"
	help
	  Use cache size 32K
endchoice

# OTA
config OTA
    bool "OTA"
    default n
    help
        If this option is enabled, OTA used.

# ota policy, choose ota mode
choice
	prompt "OTA Policy Select"
	depends on OTA
	default OTA_POLICY_PINGPONG
	help
	  Select OTA mode.

config OTA_POLICY_PINGPONG
	bool "ping pong mode"
	help
	  Select ping pang mode.
config OTA_POLICY_IMAGE_COMPRESSION
	bool "image compression mode"
	help
	  Select image compression mode.
endchoice


# xplayer
config XPLAYER
	bool "Xplayer support"
	default n
	help
		xplayer.


if CHIP_TYPE_XR872
# JPEG
config JPEG
	bool "JPEG"
	default n
	help
		JPEG.

config JPEG_SHAR_SRAM_64K
	bool "JPEG_SHAR_SRAM_64K"
	depends on JPEG
	default n
	help
		JPEG.
endif


# bin compression
config BIN_COMPRESS
	bool "Bin compression"
	default n
	help
		bin compression for decompress bins(eg. wlan_fw.bin).


# bench mark
config BENCH_MARK
	bool "Bench mark"
	default n
	help
		bench mark.


# MSP stack size set
config MSP_STACK_SIZE
	int "Interrupt stack size"
	default 1024
	help
	  the stack size for config CPU MSP.


# enable/disable bootloader, y to enable bootloader and disable some features
config BOOTLOADER
	bool "Build bootloader"
	default n
	help
		set y to disable some features when build bootloader.

endmenu
```

## project/bootloader/gcc/defconfig
```kconfig
CONFIG_PROJECT="bootloader"
CONFIG_BOOTLOADER=y
CONFIG_BOARD="xradio_bl"
# CONFIG_XIP is not set
CONFIG_BIN_COMPRESS=y
# CONFIG_FILESYSTEMS is not set
```

## project/bootloader/gcc/tz_defconfig
```kconfig
CONFIG_PROJECT="bootloader"
# CONFIG_XIP is not set
CONFIG_PSRAM=y
CONFIG_BIN_COMPRESS=y
CONFIG_BOOTLOADER=y
# CONFIG_PSRAM_HEAP_WRITETHROUGH is not set
CONFIG_SECURE_BOOT=y
CONFIG_TRUSTZONE_BOOT=y
CONFIG_TZ_ROM=y
CONFIG_TZ_PSRAM=y
CONFIG_TZ_PSRAM_SIZE=32
```

## project/demo/at_demo/gcc/defconfig
```kconfig
CONFIG_PROJECT="demo/at_demo"
CONFIG_XIP=y
CONFIG_OTA=y
CONFIG_WLAN=y
# CONFIG_BLE_FEATURE is not set
```

## project/demo/audio_demo/gcc/defconfig
```kconfig
CONFIG_PROJECT="demo/audio_demo"
CONFIG_XIP=y
CONFIG_XPLAYER=y
CONFIG_WLAN=y
CONFIG_FILESYSTEMS=y
CONFIG_LITTLE_FS=y
CONFIG_LITTLE_FS_START_ADDR=1572864
CONFIG_LITTLE_FS_BLOCK_SIZE=4096
CONFIG_LITTLE_FS_BLOCK_COUNT=128
```

## project/demo/wlan_ble_demo/gcc/defconfig
```kconfig
CONFIG_PROJECT="demo/wlan_ble_demo"

CONFIG_XIP=y
# CONFIG_PSRAM is not set
# CONFIG_OTA is not set
CONFIG_PM=y

CONFIG_WLAN=y

CONFIG_BLE_FEATURE=y
CONFIG_BLE=y
CONFIG_BT=y
CONFIG_BLEHOST=y
CONFIG_BLEHOST_Z_ITERABLE_SECTION=y
CONFIG_BT_LOG_LEVEL_INF=y
CONFIG_BT_LOG_LEVEL=3
CONFIG_BT_HCI=y
CONFIG_BT_PERIPHERAL=y
CONFIG_BT_CENTRAL=y
CONFIG_BT_BROADCASTER=y
CONFIG_BT_OBSERVER=y
CONFIG_BT_CONN=y
CONFIG_BT_MAX_CONN=5
CONFIG_BT_HCI_ACL_FLOW_CONTROL=y
CONFIG_BT_REMOTE_VERSION=y
CONFIG_BT_PHY_UPDATE=y
CONFIG_BT_DATA_LEN_UPDATE=y
CONFIG_BT_RPA=y
CONFIG_BT_ASSERT=y
CONFIG_BT_ASSERT_VERBOSE=y
# CONFIG_BT_ASSERT_PANIC is not set
CONFIG_BT_DEBUG=y
# CONFIG_BT_DEBUG_NONE is not set
# CONFIG_BT_DEBUG_LOG is not set
# CONFIG_BT_DEBUG_LOG_WITH_HCI_PRINT is not set
CONFIG_BTSNOOP=y
# CONFIG_BT_DEBUG_RPA is not set

CONFIG_NET_BUF=y
CONFIG_NET_BUF_USER_DATA_SIZE=4
CONFIG_NET_BUF_LOG_LEVEL_INF=y
CONFIG_NET_BUF_LOG_LEVEL=3

CONFIG_ASSERT=y
CONFIG_ASSERT_LEVEL=2
# CONFIG_FORCE_NO_ASSERT is not set

CONFIG_LOG=y

CONFIG_LOG_DEFAULT_LEVEL=3

CONFIG_LOG_FUNC_NAME_PREFIX_ERR=y
CONFIG_LOG_FUNC_NAME_PREFIX_WRN=y
CONFIG_LOG_FUNC_NAME_PREFIX_INF=y
CONFIG_LOG_FUNC_NAME_PREFIX_DBG=y

# CONFIG_LOG_BACKEND_SHOW_COLOR is not set
CONFIG_LOG_SHOW_TAGS=y

CONFIG_SETTINGS=y
# CONFIG_SETTINGS_RUNTIME is not set
CONFIG_SETTINGS_ENCODE_LEN=y
# CONFIG_SETTINGS_USE_BASE64 is not set
CONFIG_SETTINGS_FS=y
CONFIG_SETTINGS_FS_DIR="data/settings"
CONFIG_SETTINGS_FS_FILE="data/settings/run"
CONFIG_SETTINGS_FS_MAX_LINES=256

CONFIG_BT_SETTINGS=y
CONFIG_BT_SETTINGS_CCC_LAZY_LOADING=y
# CONFIG_BT_SETTINGS_CCC_STORE_ON_WRITE is not set
CONFIG_BT_WHITELIST=y
CONFIG_BT_ACL_RX_COUNT=6
CONFIG_BT_CONN_TX_MAX=3
CONFIG_BT_USER_PHY_UPDATE=y
# CONFIG_BT_AUTO_PHY_UPDATE is not set
CONFIG_BT_USER_DATA_LEN_UPDATE=y
# CONFIG_BT_AUTO_DATA_LEN_UPDATE is not set
CONFIG_BT_REMOTE_INFO=y
CONFIG_BT_SMP=y
CONFIG_BT_PRIVACY=y
CONFIG_BT_RPA_TIMEOUT=900
CONFIG_BT_SIGNING=y
CONFIG_BT_SMP_APP_PAIRING_ACCEPT=y
# CONFIG_BT_SMP_SC_PAIR_ONLY is not set
# CONFIG_BT_SMP_SC_ONLY is not set
# CONFIG_BT_SMP_OOB_LEGACY_PAIR_ONLY is not set
# CONFIG_BT_SMP_DISABLE_LEGACY_JW_PASSKEY is not set
CONFIG_BT_SMP_ALLOW_UNAUTH_OVERWRITE=y
# CONFIG_BT_FIXED_PASSKEY is not set
# CONFIG_BT_USE_DEBUG_KEYS is not set
CONFIG_BT_BONDABLE=y
# CONFIG_BT_BONDING_REQUIRED is not set
# CONFIG_BT_STORE_DEBUG_KEYS is not set
CONFIG_BT_SMP_ENFORCE_MITM=y
CONFIG_BT_KEYS_OVERWRITE_OLDEST=y
# CONFIG_BT_KEYS_SAVE_AGING_COUNTER_ON_PAIRING is not set

CONFIG_BT_L2CAP_RX_MTU=65
CONFIG_BT_L2CAP_TX_BUF_COUNT=3
CONFIG_BT_L2CAP_TX_FRAG_COUNT=2
CONFIG_BT_L2CAP_TX_MTU=65
# CONFIG_BT_L2CAP_DYNAMIC_CHANNEL is not set
# CONFIG_BT_DEBUG_L2CAP is not set

# CONFIG_BT_ATT_ENFORCE_FLOW is not set
CONFIG_BT_ATT_PREPARE_COUNT=0
CONFIG_BT_ATT_TX_MAX=3
CONFIG_BT_GATT_SERVICE_CHANGED=y
CONFIG_BT_GATT_DYNAMIC_DB=y
# CONFIG_BT_GATT_CACHING is not set
CONFIG_BT_GATT_CLIENT=y
CONFIG_BT_GATT_READ_MULTIPLE=y
CONFIG_BT_GATT_AUTO_DISCOVER_CCC=y
CONFIG_BT_GAP_AUTO_UPDATE_CONN_PARAMS=y
# CONFIG_BT_GAP_PERIPHERAL_PREF_PARAMS is not set
CONFIG_BT_DEVICE_NAME_GATT_WRITABLE=y
# CONFIG_BT_DEBUG_ATT is not set
# CONFIG_BT_DEBUG_GATT is not set

CONFIG_BT_MAX_PAIRED=5
CONFIG_BT_CREATE_CONN_TIMEOUT=3
CONFIG_BT_CONN_PARAM_UPDATE_TIMEOUT=5000
CONFIG_BT_BACKGROUND_SCAN_INTERVAL=2048
CONFIG_BT_BACKGROUND_SCAN_WINDOW=18
CONFIG_BT_DEVICE_NAME_DYNAMIC=y
CONFIG_BT_DEVICE_NAME_MAX=28
CONFIG_BT_DEVICE_NAME="Xradio"
CONFIG_BT_DEVICE_APPEARANCE=0
CONFIG_BT_ID_MAX=1
# CONFIG_BT_DF is not set
CONFIG_BT_ECC=y
CONFIG_BT_TINYCRYPT_ECC=y
CONFIG_BT_HOST_CCM=y
CONFIG_BT_MESH=y
CONFIG_BT_MESH_PROV=y
CONFIG_BT_MESH_PROV_DEVICE=y
CONFIG_BT_MESH_PB_ADV=y
CONFIG_BT_MESH_UNPROV_BEACON_INT=5
CONFIG_BT_MESH_PB_ADV_RETRANS_TIMEOUT=500
CONFIG_BT_MESH_PROVISIONER=y
CONFIG_BT_MESH_CDB=y
CONFIG_BT_MESH_CDB_NODE_COUNT=32
CONFIG_BT_MESH_CDB_SUBNET_COUNT=3
CONFIG_BT_MESH_CDB_APP_KEY_COUNT=3
CONFIG_BT_MESH_PROXY=y
CONFIG_BT_MESH_PB_GATT=y
CONFIG_BT_MESH_GATT_PROXY=y
CONFIG_BT_MESH_GATT_PROXY_ENABLED=y
CONFIG_BT_MESH_NODE_ID_TIMEOUT=60
CONFIG_BT_MESH_PROXY_FILTER_SIZE=3
# CONFIG_BT_MESH_SELF_TEST is not set
# CONFIG_BT_MESH_IV_UPDATE_TEST is not set
CONFIG_BT_MESH_KEY_REFRESH=y
CONFIG_BT_MESH_SUBNET_COUNT=3
CONFIG_BT_MESH_APP_KEY_COUNT=3
CONFIG_BT_MESH_MODEL_KEY_COUNT=1
CONFIG_BT_MESH_MODEL_GROUP_COUNT=3
CONFIG_BT_MESH_LABEL_COUNT=3
CONFIG_BT_MESH_CRPL=32
CONFIG_BT_MESH_MSG_CACHE_SIZE=10
CONFIG_BT_MESH_ADV_BUF_COUNT=6
CONFIG_BT_MESH_ADV_LEGACY=y
CONFIG_BT_MESH_ADV_STACK_SIZE=1024
CONFIG_BT_MESH_ADV_THREAD_PRIO=2
CONFIG_BT_MESH_IVU_DIVIDER=4
CONFIG_BT_MESH_TX_SEG_MSG_COUNT=2
CONFIG_BT_MESH_RX_SEG_MSG_COUNT=1
CONFIG_BT_MESH_SEG_BUFS=64
CONFIG_BT_MESH_RX_SEG_MAX=3
CONFIG_BT_MESH_TX_SEG_MAX=3
CONFIG_BT_MESH_DEFAULT_TTL=7
CONFIG_BT_MESH_LOOPBACK_BUFS=3
CONFIG_BT_MESH_TX_SEG_RETRANS_COUNT=4
CONFIG_BT_MESH_TX_SEG_RETRANS_TIMEOUT_UNICAST=400
CONFIG_BT_MESH_TX_SEG_RETRANS_TIMEOUT_GROUP=50
CONFIG_BT_MESH_NETWORK_TRANSMIT_COUNT=2
CONFIG_BT_MESH_NETWORK_TRANSMIT_INTERVAL=20
CONFIG_BT_MESH_RELAY=y
CONFIG_BT_MESH_RELAY_ENABLED=y
CONFIG_BT_MESH_RELAY_RETRANSMIT_COUNT=2
CONFIG_BT_MESH_RELAY_RETRANSMIT_INTERVAL=20
CONFIG_BT_MESH_BEACON_ENABLED=y
CONFIG_BT_MESH_LOW_POWER=y
CONFIG_BT_MESH_LPN_ESTABLISHMENT=y
# CONFIG_BT_MESH_LPN_AUTO is not set
CONFIG_BT_MESH_LPN_RETRY_TIMEOUT=8
CONFIG_BT_MESH_LPN_RSSI_FACTOR=0
CONFIG_BT_MESH_LPN_RECV_WIN_FACTOR=0
CONFIG_BT_MESH_LPN_MIN_QUEUE_SIZE=1
CONFIG_BT_MESH_LPN_RECV_DELAY=100
CONFIG_BT_MESH_LPN_POLL_TIMEOUT=300
CONFIG_BT_MESH_LPN_INIT_POLL_TIMEOUT=300
CONFIG_BT_MESH_LPN_SCAN_LATENCY=10
CONFIG_BT_MESH_LPN_GROUPS=8
CONFIG_BT_MESH_FRIEND=y
CONFIG_BT_MESH_FRIEND_ENABLED=y
CONFIG_BT_MESH_FRIEND_RECV_WIN=255
CONFIG_BT_MESH_FRIEND_QUEUE_SIZE=16
CONFIG_BT_MESH_FRIEND_SUB_LIST_SIZE=3
# CONFIG_BT_MESH_LPN_SUB_ALL_NODES_ADDR is not set
CONFIG_BT_MESH_FRIEND_LPN_COUNT=2
CONFIG_BT_MESH_FRIEND_SEG_RX=1
CONFIG_BT_MESH_CFG_CLI=y
CONFIG_BT_MESH_HEALTH_CLI=y
CONFIG_BT_MESH_MODEL_EXTENSIONS=y
CONFIG_BT_MESH_STORE_TIMEOUT=2
CONFIG_BT_MESH_SEQ_STORE_RATE=1024
CONFIG_BT_MESH_RPL_STORE_TIMEOUT=600
# CONFIG_BT_MESH_DEBUG is not set
CONFIG_BT_MESH_SCAN_DISABLE_ASYNC=y
CONFIG_FILESYSTEMS=y
# CONFIG_FLASH_FS_IMG_PACK is not set
# CONFIG_LITTLE_FS is not set
CONFIG_SPIF_FS=y
CONFIG_SPIF_FS_START_ADDR=1572864
CONFIG_SPIF_FS_BLOCK_SIZE=4096
CONFIG_SPIF_FS_PHY_SIZE=131072
```

## project/demo/wlan_demo/gcc/defconfig
```kconfig
CONFIG_PROJECT="demo/wlan_demo"
CONFIG_XIP=y
CONFIG_OTA=y
CONFIG_WLAN=y
# CONFIG_BLE_FEATURE is not set
```

## project/example/audio_reverb/gcc/defconfig
```kconfig
CONFIG_PROJECT="example/audio_reverb"

CONFIG_XIP=y

CONFIG_XPLAYER=y

CONFIG_FILESYSTEMS=y
CONFIG_LITTLE_FS=y
CONFIG_LITTLE_FS_START_ADDR=1572864
CONFIG_LITTLE_FS_BLOCK_SIZE=4096
CONFIG_LITTLE_FS_BLOCK_COUNT=128
```
