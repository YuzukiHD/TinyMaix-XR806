## project/example/ble/gcc/defconfig
```kconfig
CONFIG_PROJECT="example/ble"

CONFIG_XIP=y
# CONFIG_PSRAM is not set
CONFIG_OTA=y
CONFIG_OTA_POLICY_PINGPONG=y
# CONFIG_OTA_POLICY_IMAGE_COMPRESSION is not set
CONFIG_PM=y

# CONFIG_WLAN is not set
CONFIG_BLE_FEATURE=y
CONFIG_BLE=y
CONFIG_BT=y
CONFIG_BLEHOST=y
CONFIG_BLEHOST_Z_ITERABLE_SECTION=y
CONFIG_BT_LOG_LEVEL_INF=y
CONFIG_BT_LOG_LEVEL=3
CONFIG_BT_HCI=y
CONFIG_BT_PERIPHERAL=y
CONFIG_BT_CENTRAL=y
CONFIG_BT_BROADCASTER=y
CONFIG_BT_OBSERVER=y
CONFIG_BT_CONN=y
CONFIG_BT_MAX_CONN=5
CONFIG_BT_HCI_ACL_FLOW_CONTROL=y
CONFIG_BT_REMOTE_VERSION=y
CONFIG_BT_PHY_UPDATE=y
CONFIG_BT_DATA_LEN_UPDATE=y
CONFIG_BT_RPA=y
CONFIG_BT_ASSERT=y
CONFIG_BT_ASSERT_VERBOSE=y
# CONFIG_BT_ASSERT_PANIC is not set
CONFIG_BT_DEBUG=y
# CONFIG_BT_DEBUG_NONE is not set
# CONFIG_BT_DEBUG_LOG is not set
# CONFIG_BT_DEBUG_LOG_WITH_HCI_PRINT is not set
CONFIG_BTSNOOP=y
# CONFIG_BT_DEBUG_RPA is not set

CONFIG_NET_BUF=y
CONFIG_NET_BUF_USER_DATA_SIZE=4
CONFIG_NET_BUF_LOG_LEVEL_INF=y
CONFIG_NET_BUF_LOG_LEVEL=3

CONFIG_ASSERT=y
CONFIG_ASSERT_LEVEL=2
# CONFIG_FORCE_NO_ASSERT is not set

CONFIG_LOG=y

CONFIG_LOG_DEFAULT_LEVEL=3

CONFIG_LOG_FUNC_NAME_PREFIX_ERR=y
CONFIG_LOG_FUNC_NAME_PREFIX_WRN=y
CONFIG_LOG_FUNC_NAME_PREFIX_INF=y
CONFIG_LOG_FUNC_NAME_PREFIX_DBG=y

# CONFIG_LOG_BACKEND_SHOW_COLOR is not set
CONFIG_LOG_SHOW_TAGS=y

CONFIG_SETTINGS=y
# CONFIG_SETTINGS_RUNTIME is not set
CONFIG_SETTINGS_ENCODE_LEN=y
# CONFIG_SETTINGS_USE_BASE64 is not set
CONFIG_SETTINGS_FS=y
CONFIG_SETTINGS_FS_DIR="data/settings"
CONFIG_SETTINGS_FS_FILE="data/settings/run"
CONFIG_SETTINGS_FS_MAX_LINES=32

CONFIG_BT_SETTINGS=y
CONFIG_BT_SETTINGS_CCC_LAZY_LOADING=y
# CONFIG_BT_SETTINGS_CCC_STORE_ON_WRITE is not set
CONFIG_BT_WHITELIST=y
CONFIG_BT_ACL_RX_COUNT=6
CONFIG_BT_CONN_TX_MAX=3
CONFIG_BT_USER_PHY_UPDATE=y
# CONFIG_BT_AUTO_PHY_UPDATE is not set
CONFIG_BT_USER_DATA_LEN_UPDATE=y
# CONFIG_BT_AUTO_DATA_LEN_UPDATE is not set
CONFIG_BT_REMOTE_INFO=y
CONFIG_BT_SMP=y
# CONFIG_BT_PRIVACY is not set
CONFIG_BT_SIGNING=y
CONFIG_BT_SMP_APP_PAIRING_ACCEPT=y
# CONFIG_BT_SMP_SC_PAIR_ONLY is not set
# CONFIG_BT_SMP_SC_ONLY is not set
# CONFIG_BT_SMP_OOB_LEGACY_PAIR_ONLY is not set
# CONFIG_BT_SMP_DISABLE_LEGACY_JW_PASSKEY is not set
CONFIG_BT_SMP_ALLOW_UNAUTH_OVERWRITE=y
CONFIG_BT_FIXED_PASSKEY=y
# CONFIG_BT_USE_DEBUG_KEYS is not set
CONFIG_BT_BONDABLE=y
# CONFIG_BT_BONDING_REQUIRED is not set
# CONFIG_BT_STORE_DEBUG_KEYS is not set
CONFIG_BT_SMP_ENFORCE_MITM=y
CONFIG_BT_KEYS_OVERWRITE_OLDEST=y
# CONFIG_BT_KEYS_SAVE_AGING_COUNTER_ON_PAIRING is not set

CONFIG_BT_L2CAP_RX_MTU=65
CONFIG_BT_L2CAP_TX_BUF_COUNT=3
CONFIG_BT_L2CAP_TX_FRAG_COUNT=2
CONFIG_BT_L2CAP_TX_MTU=65
# CONFIG_BT_L2CAP_DYNAMIC_CHANNEL is not set
# CONFIG_BT_DEBUG_L2CAP is not set

# CONFIG_BT_ATT_ENFORCE_FLOW is not set
CONFIG_BT_ATT_PREPARE_COUNT=0
CONFIG_BT_ATT_TX_MAX=3
CONFIG_BT_GATT_SERVICE_CHANGED=y
CONFIG_BT_GATT_DYNAMIC_DB=y
CONFIG_BT_GATT_CACHING=y
CONFIG_BT_GATT_NOTIFY_MULTIPLE=y
# CONFIG_BT_GATT_ENFORCE_CHANGE_UNAWARE is not set
CONFIG_BT_GATT_CLIENT=y
CONFIG_BT_GATT_READ_MULTIPLE=y
# CONFIG_BT_GATT_AUTO_DISCOVER_CCC is not set
CONFIG_BT_GAP_AUTO_UPDATE_CONN_PARAMS=y
CONFIG_BT_GAP_PERIPHERAL_PREF_PARAMS=y
CONFIG_BT_PERIPHERAL_PREF_MIN_INT=24
CONFIG_BT_PERIPHERAL_PREF_MAX_INT=40
CONFIG_BT_PERIPHERAL_PREF_SLAVE_LATENCY=0
CONFIG_BT_PERIPHERAL_PREF_TIMEOUT=42
CONFIG_BT_DEVICE_NAME_GATT_WRITABLE=y
# CONFIG_BT_DEBUG_ATT is not set
# CONFIG_BT_DEBUG_GATT is not set

CONFIG_BT_MAX_PAIRED=5
CONFIG_BT_CREATE_CONN_TIMEOUT=3
CONFIG_BT_CONN_PARAM_UPDATE_TIMEOUT=5000
CONFIG_BT_BACKGROUND_SCAN_INTERVAL=2048
CONFIG_BT_BACKGROUND_SCAN_WINDOW=18
CONFIG_BT_DEVICE_NAME_DYNAMIC=y
CONFIG_BT_DEVICE_NAME_MAX=28
CONFIG_BT_DEVICE_NAME="Xradio"
CONFIG_BT_DEVICE_APPEARANCE=0
CONFIG_BT_ID_MAX=1
# CONFIG_BT_DF is not set
CONFIG_BT_ECC=y
CONFIG_BT_TINYCRYPT_ECC=y
CONFIG_BT_HOST_CCM=y
# CONFIG_BT_MESH is not set
CONFIG_FILESYSTEMS=y
# CONFIG_FLASH_FS_IMG_PACK is not set
# CONFIG_LITTLE_FS is not set
CONFIG_SPIF_FS=y
CONFIG_SPIF_FS_START_ADDR=1572864
CONFIG_SPIF_FS_BLOCK_SIZE=4096
CONFIG_SPIF_FS_PHY_SIZE=131072
```

## project/example/blink/gcc/defconfig
```kconfig
CONFIG_PROJECT="example/blink"
CONFIG_XIP=y
CONFIG_WLAN=y
CONFIG_MBUF_IMPL_MODE=0
CONFIG_BLE_FEATURE=y
CONFIG_BLE=y
CONFIG_BT=y
CONFIG_BLEHOST=y
CONFIG_BT_HCI=y
# CONFIG_BT_CUSTOM is not set
# CONFIG_BT_HCI_RAW is not set
CONFIG_BT_PERIPHERAL=y
CONFIG_BT_CENTRAL=y
CONFIG_BT_BROADCASTER=y
# CONFIG_BT_EXT_ADV is not set
CONFIG_BT_OBSERVER=y
CONFIG_BT_CONN=y
CONFIG_BT_MAX_CONN=5
CONFIG_BT_HCI_ACL_FLOW_CONTROL=y
CONFIG_BT_REMOTE_VERSION=y
CONFIG_BT_PHY_UPDATE=y
CONFIG_BT_DATA_LEN_UPDATE=y
CONFIG_BT_RPA=y
CONFIG_BT_ASSERT=y
CONFIG_BT_ASSERT_VERBOSE=y
# CONFIG_BT_ASSERT_PANIC is not set
CONFIG_BT_DEBUG=y
# CONFIG_BT_DEBUG_NONE is not set
# CONFIG_BT_DEBUG_LOG is not set
# CONFIG_BT_DEBUG_LOG_WITH_HCI_PRINT is not set
CONFIG_BTSNOOP=y
# CONFIG_BT_DEBUG_RPA is not set

CONFIG_NET_BUF=y
CONFIG_NET_BUF_USER_DATA_SIZE=4
CONFIG_NET_BUF_LOG_LEVEL_INF=y
CONFIG_NET_BUF_LOG_LEVEL=3

CONFIG_ASSERT=y
CONFIG_ASSERT_LEVEL=2
# CONFIG_FORCE_NO_ASSERT is not set

CONFIG_LOG=y

CONFIG_LOG_DEFAULT_LEVEL=3

CONFIG_LOG_FUNC_NAME_PREFIX_ERR=y
CONFIG_LOG_FUNC_NAME_PREFIX_WRN=y
CONFIG_LOG_FUNC_NAME_PREFIX_INF=y
CONFIG_LOG_FUNC_NAME_PREFIX_DBG=y

# CONFIG_LOG_BACKEND_SHOW_COLOR is not set
CONFIG_LOG_SHOW_TAGS=y

CONFIG_SETTINGS=y
# CONFIG_SETTINGS_RUNTIME is not set
CONFIG_SETTINGS_ENCODE_LEN=y
# CONFIG_SETTINGS_USE_BASE64 is not set
CONFIG_SETTINGS_FS=y
CONFIG_SETTINGS_FS_DIR="data/settings"
CONFIG_SETTINGS_FS_FILE="data/settings/run"
CONFIG_SETTINGS_FS_MAX_LINES=256

CONFIG_BT_SETTINGS=y
CONFIG_BT_SETTINGS_CCC_LAZY_LOADING=y
# CONFIG_BT_SETTINGS_CCC_STORE_ON_WRITE is not set
CONFIG_BT_WHITELIST=y
CONFIG_BT_ACL_RX_COUNT=6
CONFIG_BT_CONN_TX_MAX=3
CONFIG_BT_USER_PHY_UPDATE=y
# CONFIG_BT_AUTO_PHY_UPDATE is not set
CONFIG_BT_USER_DATA_LEN_UPDATE=y
# CONFIG_BT_AUTO_DATA_LEN_UPDATE is not set
CONFIG_BT_REMOTE_INFO=y
CONFIG_BT_SMP=y
CONFIG_BT_PRIVACY=y
CONFIG_BT_RPA_TIMEOUT=900
CONFIG_BT_SIGNING=y
CONFIG_BT_SMP_APP_PAIRING_ACCEPT=y
# CONFIG_BT_SMP_SC_PAIR_ONLY is not set
# CONFIG_BT_SMP_SC_ONLY is not set
# CONFIG_BT_SMP_OOB_LEGACY_PAIR_ONLY is not set
# CONFIG_BT_SMP_DISABLE_LEGACY_JW_PASSKEY is not set
CONFIG_BT_SMP_ALLOW_UNAUTH_OVERWRITE=y
# CONFIG_BT_FIXED_PASSKEY is not set
# CONFIG_BT_USE_DEBUG_KEYS is not set
CONFIG_BT_BONDABLE=y
# CONFIG_BT_BONDING_REQUIRED is not set
# CONFIG_BT_STORE_DEBUG_KEYS is not set
CONFIG_BT_SMP_ENFORCE_MITM=y
CONFIG_BT_KEYS_OVERWRITE_OLDEST=y
CONFIG_BT_L2CAP_RX_MTU=65
CONFIG_BT_L2CAP_TX_BUF_COUNT=3
CONFIG_BT_L2CAP_TX_FRAG_COUNT=2
CONFIG_BT_L2CAP_TX_MTU=65
# CONFIG_BT_L2CAP_DYNAMIC_CHANNEL is not set
# CONFIG_BT_DEBUG_L2CAP is not set
CONFIG_BT_ATT_ENFORCE_FLOW=y
CONFIG_BT_ATT_PREPARE_COUNT=0
CONFIG_BT_ATT_TX_MAX=3
CONFIG_BT_GATT_SERVICE_CHANGED=y
CONFIG_BT_GATT_DYNAMIC_DB=y
CONFIG_BT_GATT_CACHING=y
CONFIG_BT_GATT_NOTIFY_MULTIPLE=y
# CONFIG_BT_GATT_ENFORCE_CHANGE_UNAWARE is not set
CONFIG_BT_GATT_CLIENT=y
CONFIG_BT_GATT_READ_MULTIPLE=y
CONFIG_BT_GATT_AUTO_DISCOVER_CCC=y
CONFIG_BT_GAP_AUTO_UPDATE_CONN_PARAMS=y
# CONFIG_BT_GAP_PERIPHERAL_PREF_PARAMS is not set
CONFIG_BT_DEVICE_NAME_GATT_WRITABLE=y
# CONFIG_BT_DEBUG_ATT is not set
# CONFIG_BT_DEBUG_GATT is not set
CONFIG_BT_MAX_PAIRED=5
CONFIG_BT_CREATE_CONN_TIMEOUT=3
CONFIG_BT_CONN_PARAM_UPDATE_TIMEOUT=5000
CONFIG_BT_BACKGROUND_SCAN_INTERVAL=2048
CONFIG_BT_BACKGROUND_SCAN_WINDOW=18
CONFIG_BT_DEVICE_NAME_DYNAMIC=y
CONFIG_BT_DEVICE_NAME_MAX=28
CONFIG_BT_DEVICE_NAME="Xradio"
CONFIG_BT_DEVICE_APPEARANCE=0
CONFIG_BT_ID_MAX=1
# CONFIG_BT_DF is not set
CONFIG_BT_ECC=y
CONFIG_BT_TINYCRYPT_ECC=y
CONFIG_BT_HOST_CCM=y
# CONFIG_BT_DEBUG_HCI_CORE is not set
# CONFIG_BT_DEBUG_CONN is not set
# CONFIG_BT_DEBUG_KEYS is not set
# CONFIG_BT_DEBUG_SMP is not set
# CONFIG_BT_DEBUG_SERVICE is not set
# CONFIG_BT_MESH is not set
CONFIG_FILESYSTEMS=y
# CONFIG_FLASH_FS_IMG_PACK is not set
# CONFIG_LITTLE_FS is not set
CONFIG_SPIF_FS=y
CONFIG_SPIF_FS_START_ADDR=1572864
CONFIG_SPIF_FS_BLOCK_SIZE=4096
CONFIG_SPIF_FS_PHY_SIZE=131072
```
