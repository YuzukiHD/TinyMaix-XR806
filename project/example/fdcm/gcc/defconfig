## project/example/matrix_button/gcc/defconfig
```kconfig
CONFIG_PROJECT="example/matrix_button"
#CONFIG_XIP is not set
#CONFIG_WLAN is not set
```

## project/example/pm/gcc/defconfig
```kconfig
CONFIG_PROJECT="example/pm"
CONFIG_WLAN=y
# CONFIG_BLE_FEATURE is not set
CONFIG_PM=y
```

## project/example/soft_ap_config/gcc/defconfig
```kconfig
CONFIG_PROJECT="example/soft_ap_config"
CONFIG_XIP=y
CONFIG_WLAN=y
CONFIG_WLAN_STA=y
CONFIG_WLAN_AP=y
```
