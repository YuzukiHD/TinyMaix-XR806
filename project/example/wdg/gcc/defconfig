## project/example/wlan/gcc/defconfig
```kconfig
CONFIG_PROJECT="example/wlan"
CONFIG_XIP=y
CONFIG_WLAN=y
CONFIG_WLAN_STA=y
CONFIG_WLAN_AP=y
```

## project/example/wlan_low_power/gcc/defconfig
```kconfig
CONFIG_PROJECT="example/wlan_low_power"
CONFIG_XIP=y
CONFIG_WLAN=y
CONFIG_WLAN_STA=y
```

## project/test/etf/gcc/defconfig
```kconfig
CONFIG_PROJECT="test/etf"
CONFIG_XIP=y
CONFIG_WLAN=y
CONFIG_BLE_FEATURE=y
CONFIG_BLE=y
# CONFIG_BT is not set
# CONFIG_OTA is not set
# CONFIG_WIFI_CERTIFIED is not set
# CONFIG_WLAN_STA is not set
# CONFIG_WLAN_MONITOR is not set
# CONFIG_WLAN_AP is not set
CONFIG_ETF_CLI=y
CONFIG_ETF=y
```

## src/debug/Kconfig
```kconfig
#
# Debug configuration
#

menu "Debug options"


# statistical cpuusage
config OS_DEBUG_CPU_USAGE
	bool "Debug CPU usage"
	depends on OS_FREERTOS
	default n
	help
	  CPU usage is supported if selected, only used in debug mode for this will cost more power.

# seconds of cpu usage info print
config OS_DEBUG_CPU_USAGE_SECONDS
	int "seconds of cpu usage info print"
	depends on OS_DEBUG_CPU_USAGE
	default 1
	help
		0: not print cpuusage info, get cpuusage info by interface; other: seconds of cpu usage print.

# trace heap memory usage and error when using malloc, free, etc.
config MALLOC_TRACE
	bool "Trace heap memory usage and error"
	default n
	help
		trace heap memory usage and error when using malloc, free.

# backtrace for debug.
config BACKTRACE
	bool "backtrace"
	default n
	help
		backtrace for debug.

# watchpoint for debug.
config WATCHPOINT
	bool "watchpoint"
	default n
	help
		watchpoint for debug.

# heap debug.
config HEAP_FREE_CHECK
	bool "Check heap free parameter"
	default n
	help
		heap debug.

# trace psram heap memory usage and error when using malloc, free, etc.
config PSRAM_MALLOC_TRACE
	bool "Trace psram heap memory usage and error"
	default n
	help
		trace psram heap memory usage and error when using malloc, free.

# rom of FreeRTOS
config ROM_FREERTOS
	bool
	depends on ROM && !OS_DEBUG_CPU_USAGE && FREERTOS_VER_10_2_1
	default y
	help
	  FreeRTOS rom code used


# reduce debug message
config REDUCE_DBG_MSG
	bool "Reduce debug message"
	default n
	help
		reduce debug message.


# reduce RAM usage
config REDUCE_RAM
	bool "Reduce RAM usage"
	default n
	help
		reduce RAM usage.

config WLAN_SHARE_RAM
	bool "wlan share app sram"
	default n
	depends on WLAN
	help
		wlan share app sram for wlan debug.

# Wlan share app sram size select
choice
	prompt "wlan share app sram size"
	depends on WLAN_SHARE_RAM
	default WLAN_SHARE_RAM_SIZE_96K
	help
		Select wlan share app sram size.

config WLAN_SHARE_RAM_SIZE_16K
	bool "16k"
	help
		Share app sram size 16K
config WLAN_SHARE_RAM_SIZE_32K
	bool "32k"
	help
		Share app sram size 32K
config WLAN_SHARE_RAM_SIZE_64K
	bool "64k"
	help
		Share app sram size 64K
config WLAN_SHARE_RAM_SIZE_96K
	bool "96k"
	help
		Share app sram size 96K
config WLAN_SHARE_RAM_SIZE_128K
	bool "128k"
	help
		Share app sram size 128K
endchoice


# use external flash only
config EXT_FLASH_ONLY
	bool "use external flash only"
	default n
	help
		force to use external flash whether sip flash exist or not.


# rom
config ROM
	bool
	default y
	help
		Used ROM code.

# rom of xz
config ROM_XZ
	bool
	default y
	help
		Used XZ ROM code.

endmenu
```

## src/driver/chip/Kconfig
```kconfig
#
# Devices configuration
#

menu "Devices options"


# Disable IRQ during flash erasing/writing
config FLASH_ERASE_WRITE_DISABLE_IRQ
	bool "Disable IRQ during flash erasing/writing"
	default n
	help
		When this option is selected, interrupt codes are allowed to be placed in XIP or PSRAM.
		However, interrupt response may be delayed or missed during flash erasing or writing.

# flash block lock support
config FLASH_POWER_DOWN_PROTECT
	bool "flash data protect when power down(during erase/write)"
	default n
	help
		 Use flash block lock mode during erasing/writing to protect flash data in case of accidental power down.

# flash pm config
config FLASH_PM_ALLOW_ENTER_PWR_DOWN
	bool "flash enter power-down mode in pm(standby/hibernation)"
	depends on PM
	default y
	help
		 Allow Flash to enter power-down mode in standby or hibernation state.

source "src/driver/chip/psram/Kconfig"

source "src/driver/chip/sdmmc/Kconfig"

config IR_USED_CLK_32K
	bool "ir use 32K"
		default n

endmenu
```

## src/driver/chip/psram/Kconfig
```kconfig
menu "PSRAM Devices"

if PSRAM

# Psram select
choice
	prompt "Psram Select"
	depends on PSRAM
	default PSRAM_CHIP_SQPI
	help
	  Select Psram.

config PSRAM_CHIP_SQPI
	bool "sqpi"
	depends on CHIP_XR806
	help
		Select Psram sqpi
if CHIP_TYPE_XR872 || CHIP_TYPE_XR808
config PSRAM_CHIP_OPI32
	bool "opi32"
	help
		Select Psram opi32
config PSRAM_CHIP_OPI64
	bool "opi64"
	help
		Select Psram opi64
endif
endchoice

# Psram freq config
choice
	prompt "Psram freq config"
	depends on PSRAM
	default PSRAM_FREQ_96M
	help
	  Config psram frequency.

config PSRAM_FREQ_96M
	bool "96MHz"
	help
		Config psram frequency to 96MHz
config PSRAM_FREQ_120M
	bool "120MHz"
	help
		Config psram frequency to 120MHz
endchoice

# Psram heap writethrough config
config PSRAM_HEAP_WRITETHROUGH
	bool "Psram heap writethrough"
	depends on PSRAM
	default n
	---help---
		Psram heap writethrough or cacheable.

# Psram check data before suspend and after resume
config PSRAM_PM_DATA_CHECK
	bool "Psram check data before suspend and after resume"
	depends on PSRAM && PM
	default n
	help
		Check psram data after resume compared with check data before suspend.

endif
endmenu
```

## src/driver/chip/sdmmc/Kconfig
```kconfig
menu "SDMMC Devices"

config DRIVERS_SDMMC
    bool "enable SDMMC drivers"
	depends on CHIP_TYPE_XR872 || CHIP_TYPE_XR808
    default y

if DRIVERS_SDMMC

config USE_SD
	bool "enable SD"
	default y

# not support now!
#config SD_SUPPORT_VERSION3
#	bool "support SD VERSION3"
#	default n

config USE_SDIO
	bool "enable SDIO"
	default y

# not support now!
#config USE_SDIO_COMBO
#	bool "enable SDIO COMBO"
#	depends on USE_SDIO
#	default n

# not support now!
#config USE_SDIO_FUNS
#	bool "enable SDIO FUNS"
#	depends on USE_SDIO
#	default n

config USE_MMC
	bool "enable mmc"
	default n

# not support now
config USE_MMC_QUIRK
	bool "enable mmc quirk"
	depends on USE_MMC
	default n

config DETECT_CARD
    bool "enable detect card"
    default y

config SDIO_IRQ_SUPPORT
	bool "enable sdio irq"
	default y

config SDC_DMA_USED
	bool "enable dma transmission"
	default y

config SDC_DMA_BUF_SIZE
	int "SD Card Align DMA Buffer Size(Kbyte)."
	depends on SDC_DMA_USED
	default 64

config SD_TEST
	select USE_SD
	bool "enable SD Card test case."
	default y

config SDIO_DEBUG
	bool "enable sdio debug"
	default n

endif
endmenu
```

## src/fs/Kconfig
```kconfig
#
# File systems
#

# fatfs
config FAT_FS
	bool "FAT filesystem support"
	depends on SDMMC
	default y
	---help---
		FAT filesystem support.

# flash fs image pack
config FLASH_FS_IMG_PACK
	bool "flash filesystem image pack support"
	default n
	help
		If this option is enabled, flash filesystem bin will be pack to image.

# flash file systems
choice
	prompt "FileSystem Type Select"
	default LITTLE_FS
	help
		Select FS type.

# littlefs
config LITTLE_FS
	bool "LittleFS"
	---help---
		little filesystem support.
# spiffs
config SPIF_FS
	bool "SPIFFS"
	---help---
		spiffs filesystem support.
endchoice

if LITTLE_FS
config LITTLE_FS_START_ADDR
	int "little filesystem start address"
	default 1572864
	---help---
		little filesystem start address.

config LITTLE_FS_BLOCK_SIZE
	int "little filesystem block size"
	default 4096
	---help---
		little filesystem block size.

config LITTLE_FS_BLOCK_COUNT
	int "little filesystem block count"
	default 128
	---help---
		little filesystem block count.
endif

if SPIF_FS
config SPIF_FS_START_ADDR
	int "spiffs filesystem start address"
	default 1572864
	---help---
		spiffs filesystem start address.

config SPIF_FS_BLOCK_SIZE
	int "spiffs filesystem block size"
	default 4096
	---help---
		spiffs filesystem block size.

config SPIF_FS_PHY_SIZE
	int "spiffs filesystem physical size"
	default 131072
	---help---
		spiffs filesystem block count.
endif
```

## src/kernel/Kconfig
```kconfig
#
# Kernel configuration
#

menu "Kernel options"


# os
config OS_FREERTOS
	bool "FreeRTOS used"
	default y
	help
		FreeRTOS used.

# os version
choice
	prompt "FreeRTOS version"
	default FREERTOS_VER_10_2_1
	help
		Select FreeRTOS version.

config FREERTOS_VER_10_2_1
	bool "FreeRTOS v10.2.1"
	help
		FreeRTOS v10.2.1.
endchoice

config OS_FREERTOS_VERSION_STR
	string
	default "v10.2.1" if FREERTOS_VER_10_2_1
	help
	  FreeRTOS version Selsected


# Use os idle hook
config OS_USE_IDLE_HOOK
	bool "FreeRTOS idle hook"
	default n
	depends on ROM_FREERTOS
	help
	  Use freeRTOS idle hook


endmenu
```

## src/libc/Kconfig
```kconfig
#
# Feature configuration
#

menu "Feature options"

# redefine int32_t to signed int, but not signed long
config LIBC_REDEFINE_GCC_INT32_TYPE
	bool
	default y
	help
		redefine int32_t to signed int, but not signed long.

# support printf float variables
config LIBC_PRINTF_FLOAT
	bool
	default y
	help
		support printf float variables.

# support scanf float variables
config LIBC_SCANF_FLOAT
	bool
	default y
	help
		support scanf float variables.


# wrap standard input/output/error functions
config LIBC_WRAP_STDIO
	bool "Wrap standard input/output/error functions"
	default y
	help
		wrap standard input/output/error functions.


# heap managed by stdlib
config MALLOC_MODE
	int "Heap managed mode."
	default 0
	help
		heap managed mode. 0 for stdlib, 1 for sys_heap

# mix sram/psram heap manager
config MIX_HEAP_MANAGE
	bool "Enable mix heap manager"
	depends on PSRAM
	default n
	help
		mix sram/psram heap manager

# enable section attribute macros "__xip_xxx", eg. __xip_text
config SECTION_ATTRIBUTE_XIP
	bool "Enable section attribute macros __xip_xxx"
	depends on XIP
	default y
	help
		enable section attribute macros "__xip_xxx", eg. __xip_text.

# enable section attribute macros "__nonxip_xxx", eg. __nonxip_text
config SECTION_ATTRIBUTE_NONXIP
	bool "Enable section attribute macros __nonxip_xxx"
	depends on XIP
	default y
	help
		enable section attribute macros "__nonxip_xxx", eg. __nonxip_text.

# enable section attribute macros "__sram_xxx", eg. __sram_text
config SECTION_ATTRIBUTE_SRAM
	bool "Enable section attribute macros __sram_xxx"
	default y
	help
		enable section attribute macros "__sram_xxx", eg. __sram_text.

# enable section attribute macros "__psram_xxx", eg. __psram_text
config SECTION_ATTRIBUTE_PSRAM
	bool "Enable section attribute macros __psram_xxx"
	depends on PSRAM
	default y
	help
		enable section attribute macros "__psram_xxx", eg. __psram_text.

endmenu
```

## src/net/Kconfig
```kconfig
#
# Networking configuration
#

menu "Networking options"


# mbed TLS
config MBEDTLS_VER
	string "mbed TLS version"
	default "2.16.0"
	help
		2.2.0: mbed TLS 2.2.0, 2.16.0: mbed TLS 2.16.0.


# lwIP version
choice
	prompt "lwIP version"
	depends on WLAN
	default LWIP_VER_2_1_2
	help
		Select lwIP version.

config LWIP_VER_1_4_1
	bool "lwIP 1.4.1"
	help
		lwIP 1.4.1, support IPv4 stack only.
config LWIP_VER_2_0_3
	bool "lwIP 2.0.3"
	help
		lwIP 2.0.3, support dual IPv4/IPv6 stack.
config LWIP_VER_2_1_2
	bool "lwIP 2.1.2"
	help
		lwIP 2.1.2, support dual IPv4/IPv6 stack.
endchoice

endmenu
```

## src/pm/Kconfig
```kconfig
#
# Power management configuration
#

if PM
# wakelock support
config PM_WAKELOCKS
	bool "Wake lock"
	default y
	---help---
		 Enable wakelocks. When user request a sleep state the sleep
		 request will be delayed until no wake locks are held.


# Num of try again when suspend faild
config PM_TRY_NUM_WHEN_FAIL
	int "Num of try again when suspend faild"
	range 0 5
	default 0
	---help---
		 0 is not try again when suspend faild.


# standby retention sram config
menuconfig STANDBY_RET_SRAM
    bool "retention sram config during standby"
    default y
    help
        Sram retention config when standby.

if STANDBY_RET_SRAM
config STANDBY_RET_SRAM_ALL
	bool "ALL(0x200000~0x253FFF)"
	default y
	help
		ALL retained when standby.
config STANDBY_RET_SRAM0L_16K
	bool "SRAM0L_16K(0x200000~0x203FFF)"
	depends on !STANDBY_RET_SRAM_ALL
	default n
	help
		SRAM0L retained when standby.
config STANDBY_RET_SRAM0H_16K
	bool "SRAM0H_16K(0x204000~0x207FFF)"
	depends on !STANDBY_RET_SRAM_ALL
	default n
	help
		SRAM0H_16K retained when standby.
config STANDBY_RET_SRAM1_32K
	bool "SRAM1_32K(0x208000~0x20FFFF)"
	depends on !STANDBY_RET_SRAM_ALL
	default n
	help
		SRAM1_32K retained when standby.
config STANDBY_RET_SRAM2_3_4_96K
	bool "SRAM2_3_4_96K(0x210000~0x227FFF)"
	depends on !STANDBY_RET_SRAM_ALL
	default n
	help
		SRAM2_3_4_96K sram retained when standby.
config STANDBY_RET_SRAM5_6_7_96K
	bool "SRAM5_6_7_96K(0x228000~0x23FFFF)"
	depends on !STANDBY_RET_SRAM_ALL
	default n
	help
		SRAM5_6_7_96K sram retained when standby.
config STANDBY_RET_SRAM8_32K
	bool "SRAM8_32K(0x240000~0x247FFF)"
	depends on !STANDBY_RET_SRAM_ALL
	default n
	help
		SRAM8_32K sram retained when standby.
config STANDBY_RET_SSRAM9_10L_48K
	bool "SRAM9_10L_48K(0x248000~0x253FFF)"
	depends on !STANDBY_RET_SRAM_ALL
	default n
	help
		SRAM9_10L_48K sram retained when standby.
endif

# hibernation retention sram config
menuconfig HIBERNATION_RET_SRAM
    bool "retention sram config during hibernation"
    default n
    help
        Sram retention config when hibernation.

if  HIBERNATION_RET_SRAM
config  HIBERNATION_RET_SRAM_ALL
	bool "ALL(0x200000~0x253FFF)"
	default n
	help
		ALL retained when hibernation.
config  HIBERNATION_RET_SRAM0L_16K
	bool "SRAM0L_16K(0x200000~0x203FFF)"
	depends on !HIBERNATION_RET_SRAM_ALL
	default n
	help
		SRAM0L retained when hibernation.
config  HIBERNATION_RET_SRAM0H_16K
	bool "SRAM0H_16K(0x204000~0x207FFF)"
	depends on !HIBERNATION_RET_SRAM_ALL
	default n
	help
		SRAM0H_16K retained when hibernation.
config  HIBERNATION_RET_SRAM1_32K
	bool "SRAM1_32K(0x208000~0x20FFFF)"
	depends on !HIBERNATION_RET_SRAM_ALL
	default n
	help
		SRAM1_32K retained when hibernation.
config  HIBERNATION_RET_SRAM2_3_4_96K
	bool "SRAM2_3_4_96K(0x210000~0x227FFF)"
	depends on !HIBERNATION_RET_SRAM_ALL
	default n
	help
		SRAM2_3_4_96K sram retained when hibernation.
config  HIBERNATION_RET_SRAM5_6_7_96K
	bool "SRAM5_6_7_96K(0x228000~0x23FFFF)"
	depends on !HIBERNATION_RET_SRAM_ALL
	default n
	help
		SRAM5_6_7_96K sram retained when hibernation.
config  HIBERNATION_RET_SRAM8_32K
	bool "SRAM8_32K(0x240000~0x247FFF)"
	depends on !HIBERNATION_RET_SRAM_ALL
	default n
	help
		SRAM8_32K sram retained when hibernation.
config  HIBERNATION_RET_SSRAM9_10L_48K
	bool "SRAM9_10L_48K(0x248000~0x253FFF)"
	depends on ! HIBERNATION_RET_SRAM_ALL
	default n
	help
		SRAM9_10L_48K sram retained when hibernation.
endif


# BLE connection wakeup pin
config WAKEUP_PIN
	bool "BLE connection wakeup pin"
	depends on BLE
	default n
	---help---
		BLE connection wakeup pin.

# BLE auto enter low power
config BLE_LOW_PWR_MODE
	bool "BLE auto enter low power"
	depends on BLE
	default n
	---help---
		BLE auto enter low power.


# PM debug level, maybe "Not select the debug verbosity level to be compiled into the PM code."
config PM_DEBUG_LEVEL
	int "PM debug level"
	default 4
	range 0 6
	help
	  By default, debug messages are disabled at compiling.
	  If set at zero, this will compile out with no debug code.
	  It is recommended that it is left at 4.

endif
```
